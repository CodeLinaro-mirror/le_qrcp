## rcp_zephyr/boards/qcom/qcc743m_4/Kconfig
```kconfig
# Copyright (c) 2025 Qualcomm Technologies, Inc. and/or its subsidiaries
# SPDX-License-Identifier: Apache-2.0

config HEAP_MEM_POOL_ADD_SIZE_BOARD
	int
	default 4096
```

## rcp_zephyr/boards/qcom/qcc743m_4/Kconfig.qcc743m_4
```kconfig
# Copyright (c) 2025 Qualcomm Technologies, Inc. and/or its subsidiaries
# SPDX-License-Identifier: Apache-2.0

config BOARD_QCC743M_4
	select SOC_QCC743
```

## rcp_zephyr/boards/qcom/qcc743m_4/Kconfig.sysbuild
```kconfig
# Copyright (c) 2025 Qualcomm Technologies, Inc. and/or its subsidiaries
# SPDX-License-Identifier: Apache-2.0

choice BOOTLOADER
	default BOOTLOADER_MCUBOOT
endchoice

choice BOOT_SIGNATURE_TYPE
	default BOOT_SIGNATURE_TYPE_NONE
endchoice
```

## rcp_zephyr/boards/qcom/qcc743m_4/board.yml
```yaml
# Copyright (c) 2025 Qualcomm Technologies, Inc. and/or its subsidiaries
# SPDX-License-Identifier: Apache-2.0

board:
  name: qcc743m_4
  full_name: QCC743M-4 Module
  vendor: qcom
  socs:
    - name: qcc743
```

## rcp_zephyr/drivers/Kconfig
```kconfig
# Copyright (c) Qualcomm Technologies, Inc. and/or its subsidiaries.
# SPDX-License-Identifier: BSD-3-Clause-Clear

rsource "qualcomm_rcp/Kconfig"
rsource "qualcomm_rcp_vserial/Kconfig"
```

## rcp_zephyr/drivers/qualcomm_rcp/Kconfig
```kconfig
# Copyright (c) Qualcomm Technologies, Inc. and/or its subsidiaries.
# SPDX-License-Identifier: BSD-3-Clause-Clear

menuconfig QUALCOMM_RCP_BUS_DRIVERS
	bool "Qualcomm RCP bus drivers"
	help
	  These drivers implement Qualcomm's RCP bus API that provides generic transport
	  interface for communicating with Qualcomm RCP device.

if QUALCOMM_RCP_BUS_DRIVERS

module = QUALCOMM_RCP_BUS
module-str = qualcomm_rcp_bus
source "subsys/logging/Kconfig.template.log_config"

menuconfig QUALCOMM_RCP_BUS_SDIO_SLAVE
	bool "Qualcomm RCP bus SDIO slave driver"
	default y
	depends on DT_HAS_QCOM_RCP_BUS_SDIO_SLAVE_ENABLED
	depends on SDIO

if QUALCOMM_RCP_BUS_SDIO_SLAVE
endif # QUALCOMM_RCP_BUS_SDIO_SLAVE

menuconfig QUALCOMM_RCP_BUS_SPI_SLAVE
	bool "Qualcomm RCP bus SPI slave driver"
	default y
	depends on DT_HAS_QCOM_RCP_BUS_SPI_SLAVE_ENABLED
	depends on SPI

if QUALCOMM_RCP_BUS_SPI_SLAVE

config RCP_BUS_SPI_TX_QUEUE_SIZE
	int "SPI TX queue size"
	default 30
	help
	  Maximum number of RCP packets passed to SPI TX queue.
	  The queue only holds references to RCP packets from common pool, passed
	  by application when writing. The packets are freed after master reads
	  data from slave. The number can be set quite large in case of slow
	  master processing and a lot of RCP packets in flight.

config RCP_BUS_SPI_RX_QUEUE_SIZE
	int "SPI RX queue size"
	default 5
	help
	  Number of RCP packets in RX queue. The RX packets are acquired from common
	  pool and freed once application reads data from the driver.

endif # QUALCOMM_RCP_BUS_SPI_SLAVE

endif # QUALCOMM_RCP_BUS_DRIVERS
```

## rcp_zephyr/drivers/qualcomm_rcp_vserial/Kconfig
```kconfig
# Copyright (c) Qualcomm Technologies, Inc. and/or its subsidiaries.
# SPDX-License-Identifier: BSD-3-Clause-Clear

menuconfig QUALCOMM_RCP_VSERIAL_UART
	bool "Qualcomm RCP virtual serial UART driver"
	default y
	depends on SERIAL
	depends on DT_HAS_QCOM_RCP_VSERIAL_UART_ENABLED
	help
	  This driver exposes up to four UART-like virtual serial ports over
	  RCP streams RCP_STREAM_VSERIAL0..3.

if QUALCOMM_RCP_VSERIAL_UART

module = QUALCOMM_RCP_VSERIAL_UART
module-str = qualcomm_rcp_vserial_uart
source "subsys/logging/Kconfig.template.log_config"

config QUALCOMM_RCP_VSERIAL_RX_BUFFER_SIZE
	int "RCP virtual serial RX ring buffer size"
	range 64 4096
	default 512
	help
	  Per-port RX ring buffer size for UART data received from RCP stream.

config QUALCOMM_RCP_VSERIAL_TX_CHUNK_SIZE
	int "RCP virtual serial TX chunk size"
	range 16 512
	default 128
	help
	  Maximum payload size per RCP frame when sending UART TX data.

config QUALCOMM_RCP_VSERIAL_INIT_PRIORITY
	int "RCP vserial driver init priority"
	default 90

endif # QUALCOMM_RCP_VSERIAL_UART
```

## rcp_zephyr/dts/bindings/qcom,rcp-bus-qcspi.yaml
```yaml
# Copyright (c) Qualcomm Technologies, Inc. and/or its subsidiaries.
# SPDX-License-Identifier: BSD-3-Clause-Clear

description: |
  Qualcomm RCP bus QcSPI (QCC730 memory-mapped SPI slave)

compatible: "qcom,rcp-bus-qcspi"

include: [base.yaml]

properties:
  spi:
    type: phandle
    required: true
  irq-gpios:
    type: phandle-array
    required: true
```

## rcp_zephyr/dts/bindings/qcom,rcp-bus-sdio-slave.yml
```yaml
# Copyright (c) Qualcomm Technologies, Inc. and/or its subsidiaries.
# SPDX-License-Identifier: BSD-3-Clause-Clear

description: |
  Qualcomm RCP bus SDIO slave

compatible: "qcom,rcp-bus-sdio-slave"

include: base.yaml

on-bus: sdio
```

## rcp_zephyr/dts/bindings/qcom,rcp-bus-spi-slave.yml
```yaml
# Copyright (c) Qualcomm Technologies, Inc. and/or its subsidiaries.
# SPDX-License-Identifier: BSD-3-Clause-Clear

description: |
  Qualcomm RCP bus SPI slave

compatible: "qcom,rcp-bus-spi-slave"

include: [base.yaml]

on-bus: spi

properties:
  irq-gpios:
    type: phandle-array
    required: true
```

## rcp_zephyr/dts/bindings/qcom,rcp-vserial-uart.yml
```yaml
# Copyright (c) Qualcomm Technologies, Inc. and/or its subsidiaries.
# SPDX-License-Identifier: BSD-3-Clause-Clear

description: |
  Qualcomm RCP virtual UART endpoint

compatible: "qcom,rcp-vserial-uart"

include: uart-controller.yaml

properties:
  port:
    type: int
    required: true
    enum: [0, 1, 2, 3]
    description: |
      RCP virtual UART port index. Port 0 maps to RCP_STREAM_VSERIAL0,
      port 1 to RCP_STREAM_VSERIAL1, and so on.
```

## rcp_zephyr/modules/rcp_protocol/Kconfig
```kconfig
# Copyright (c) Qualcomm Technologies, Inc. and/or its subsidiaries.
# SPDX-License-Identifier: BSD-3-Clause-Clear

module = QUALCOMM_RCP_PROTOCOL
module-str = qualcomm_rcp_protocol
source "subsys/logging/Kconfig.template.log_config"

config QUALCOMM_RCP_PROTOCOL_NUM_BUFFERS
    int "Number of RCP protocol buffers"
    default 10
    help
      "Number of available RCP protocol buffers"

config QUALCOMM_RCP_PROTOCOL_BUFFER_SIZE
    int "Size of a single RCP protocol buffer"
    default 500
    help
      "Size of single static RCP buffer in bytes"

config QUALCOMM_RCP_RCP_MAX_TX_EVENTS
  int "Maximum length of TX message queue"
  default 10
  help
    "Maximum number of TX message queue"

config QUALCOMM_RCP_SEQ_NUM_ACK_WINDOW
  int "ACK window for RCP protocol"
  default 5
  help
    "Maximum number of intermediate messages between an RCP message and a"
    "corresponding ACK."

config QUALCOMM_RCP_VSERIAL_PORT_COUNT
    int "Number of RCP virtual serial ports"
    range 0 4
    default 0
    help
      How many RCP virtual serial UART devices to expose over RCP streams
      (0..4).

menuconfig QUALCOMM_RCP_ENCRYPTION
    bool "Enable RCP message encryption"
    default n
    depends on (MBEDTLS && MBEDTLS_PSA_CRYPTO_C)
    select PSA_WANT_ALG_SHA_256
    select PSA_WANT_ALG_HMAC
    select PSA_WANT_ALG_HKDF
    select PSA_WANT_ALG_GCM
    select PSA_WANT_ALG_ECDH
    select PSA_WANT_ALG_ECDSA
    select PSA_WANT_KEY_TYPE_AES
    select PSA_WANT_KEY_TYPE_ECC_KEY_PAIR_GENERATE
    select PSA_WANT_KEY_TYPE_ECC_KEY_PAIR_EXPORT
    select PSA_WANT_KEY_TYPE_ECC_KEY_PAIR_IMPORT
    select PSA_WANT_KEY_TYPE_ECC_PUBLIC_KEY
    select PSA_WANT_ECC_SECP_R1_256

if QUALCOMM_RCP_ENCRYPTION

config QUALCOMM_RCP_ENCRYPT_WIFI_MGMT
    bool "Encrypt WiFi management messages"
    default y

config QUALCOMM_RCP_ENCRYPT_WIFI_DATA
    bool "Encrypt WiFi data messages"
    default n

config QUALCOMM_RCP_ENCRYPT_BT
    bool "Encrypt Bluetooth HCI messages"
    default n

config QUALCOMM_RCP_ENCRYPT_THREAD
    bool "Encrypt Bluetooth Thread spinel messages"
    default n

endif # QUALCOMM_RCP_ENCRYPTION

choice QUALCOMM_RCP_DEFAULT_BUS
  bool "Default bus used by RCP protocol"
    default QUALCOMM_RCP_DEFAULT_BUS_SDIO

config QUALCOMM_RCP_DEFAULT_BUS_SDIO
  bool "RCP over SDIO by default"

config QUALCOMM_RCP_DEFAULT_BUS_SPI
  bool "RCP over SPI by default"

endchoice
```

## rcp_zephyr/west.yml
```yaml
# Copyright (c) Qualcomm Technologies, Inc. and/or its subsidiaries.
# SPDX-License-Identifier: BSD-3-Clause-Clear

manifest:
  self:
    west-commands: scripts/west-commands.yml

  remotes:
    - name: zephyrproject-rtos
      url-base: https://github.com/zephyrproject-rtos
    - name: qcc74x-github
      url-base: https://github.qualcomm.com/QCC74x

  group-filter:
    - +optional # allow nanopb import
  projects:
    - name: zephyr
      remote: zephyrproject-rtos
      revision: v4.1.0
      import:
        # By using name-allowlist we can clone only the modules that are
        # strictly needed by the application.
        name-allowlist:
          - cmsis
          - hal_nordic
          - hal_stm32
          - cmsis_6
          - mbedtls
          - nanopb
          - openthread
    - name: qcc74x_zephyr_unikie
      remote: qcc74x-github
      revision: master
      path: modules/qcc74xzephyrporting
      import:
        name-allowlist:
          - qcc74x_zephyr_hal
```
